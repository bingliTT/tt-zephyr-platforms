## tests/lib/tenstorrent/bh_arc/testcase.yaml
```yaml
common:
  tags:
    - drivers
tests:
  lib.tenstorrent.bh_arc:
    tags: smoke
    platform_allow:
      - tt_blackhole@p150a/tt_blackhole/smc
      - tt_blackhole@p300a/tt_blackhole/smc
```
