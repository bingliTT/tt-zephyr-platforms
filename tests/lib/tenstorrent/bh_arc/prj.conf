## prj.conf
```kconfig
CONFIG_ZTEST=y

# console
CONFIG_CONSOLE=y
CONFIG_RAM_CONSOLE=y

# backlog of library drivers
CONFIG_TT_BH_ARC=y
CONFIG_TT_BOOT_FS=y

# logging
CONFIG_LOG=y
CONFIG_TT_APP_LOG_LEVEL_INF=y

CONFIG_ARC_USE_UNALIGNED_MEM_ACCESS=y
CONFIG_HW_STACK_PROTECTION=n
CONFIG_SYS_CLOCK_TICKS_PER_SEC=1000

# I2C
CONFIG_MULTI_LEVEL_INTERRUPTS=y
CONFIG_I2C_DW=y
CONFIG_I2C=y
CONFIG_I2C_TARGET=y
CONFIG_SMBUS=y

# protobufs
CONFIG_NANOPB=y

# stack
# These default to 1024 on ARC.
CONFIG_MAIN_STACK_SIZE=2048
CONFIG_SYSTEM_WORKQUEUE_STACK_SIZE=2048

# perform driver-library fw and hw init prior to the application
CONFIG_TT_BH_ARC_SYSINIT=y

# Disable printing the default Zephyr boot banner
CONFIG_BOOT_BANNER=n
# Print the Tenstorrent boot banner + git version on startup
CONFIG_TT_BOOT_BANNER=y
CONFIG_TT_BOOT_BANNER_GIT_VERSION=y
CONFIG_TT_BOOT_BANNER_SDK_VERSION=y

# console
CONFIG_CONSOLE=y
CONFIG_SERIAL=y
CONFIG_UART_CONSOLE=y
CONFIG_RAM_CONSOLE=n

# disable RTT console so that we can use vuart
CONFIG_USE_SEGGER_RTT=n
CONFIG_RTT_CONSOLE=n
```

## src/eth_msg.c
```c
/*
 * Copyright (c) 2025 Tenstorrent AI ULC
 *
 * SPDX-License-Identifier: Apache-2.0
 */

#include <math.h>

#include <zephyr/ztest.h>
#include "eth.h"

ZTEST(eth_msg, test_get_status)
{
	/* Test sending a message to the ETH Mailbox */
	for (uint8_t eth_inst = 0; eth_inst < MAX_ETH_INSTANCES; eth_inst++) {
		eth_live_status_t eth_live_status;
		int retcode = getEthLiveStatus(eth_inst, 0, &eth_live_status, 1000);

		zassert_true(retcode == 0 || retcode == -EINVAL,
			"Failed to get ETH%02d live status: %d", eth_inst, retcode);
	}
}

ZTEST_SUITE(eth_msg, NULL, NULL, NULL, NULL, NULL);
```
